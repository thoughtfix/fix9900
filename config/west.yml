## config/west.yml
```yaml
manifest:
  remotes:
    - name: zmkfirmware
      url-base: https://github.com/zmkfirmware
    - name: ZitaoTech
      url-base: https://github.com/ZitaoTech
    - name: thoughtfix
      url-base: https://github.com/thoughtfix
  projects:
    - name: zmk
      remote: thoughtfix
      revision: bbkeyboard_tp-fix9900
      import: app/west.yml
  self:
    path: config
```
